## drivers/virt/gunyah/Kconfig
```kconfig
# SPDX-License-Identifier: GPL-2.0-only

config GUNYAH_HYPERCALLS
	tristate

config GUNYAH_TIMER
	tristate

config GUNYAH
	tristate "Gunyah Virtualization drivers"
	depends on ARM64
	select GUNYAH_PLATFORM_HOOKS
	select AUXILIARY_BUS
	imply GUNYAH_QCOM_PLATFORM if ARCH_QCOM
	select GUNYAH_HYPERCALLS
	select GUNYAH_TIMER
	depends on SYSFS
	select SYS_HYPERVISOR
	help
	  The Gunyah drivers are the helper interfaces that run in a guest VM
	  such as basic inter-VM IPC and signaling mechanisms, and higher level
	  services such as memory/device sharing, IRQ sharing, and so on.

	  Say Y/M here to enable the drivers needed to interact in a Gunyah
	  virtual environment.

config GUNYAH_LEND_UPFRONT
	bool "Lend all VM memory before the VM starts"
	depends on GUNYAH
	# DiamaneOS: the VM memory pool (vm_mgr_pool_mem.c)
	select GENERIC_ALLOCATOR
	help
	  Older Gunyah resource managers implement neither demand paging
	  (VM_SET_DEMAND_PAGING) nor VM_SET_ADDRESS_LAYOUT. They expect all
	  memory of a VM to be lent or shared before it starts, as the Linux
	  6.1 driver did. Qualcomm firmware for devices that launched with
	  Linux 6.1, such as SM7635, has such a resource manager.

	  With this option the binding that holds the DTB is the config image
	  parcel, every other binding is lent or shared before the VM starts,
	  and the memory is reclaimed as parcels when the VM goes away. A
	  parcel that would take a VM above 20000 physically separate pieces
	  in all its parcels is not lent: such a resource manager refuses or
	  stalls on it.

	  To keep the pieces few however scattered memory gets, set memory
	  aside at boot with reserve_mem=<size>:2M:gunyah_vm_pool. The driver
	  then offers it as /dev/gunyah_vm_pool, in 2 MiB blocks, and lends it
	  to protected VMs only. Nothing else allocates from it. Its size, free
	  and lost bytes are in /sys/class/misc/gunyah_vm_pool/.

	  Say N unless the resource manager lacks demand paging.

config GUNYAH_CMA_MEM
	bool "Gunyah VM memory from CMA regions"
	depends on GUNYAH && DMA_CMA
	# DiamaneOS: memory lent up front comes from the VM memory pool or
	# ordinary pages, which count pieces and keep memory the hypervisor
	# may hold out of use. The CMA backend does neither.
	depends on !GUNYAH_LEND_UPFRONT
	default y
	help
	  Lets a VM manager lend memory from a CMA region that the device
	  tree names for Gunyah VMs (gunyah-cma-vm-mem).

	  Say Y unless the device has no such region.

config GUNYAH_PLATFORM_HOOKS
	tristate

config GUNYAH_QCOM_PLATFORM
	tristate "Support for Gunyah on Qualcomm platforms"
	depends on GUNYAH
	select GUNYAH_PLATFORM_HOOKS
	select QCOM_SCM
	help
	  Enable support for interacting with Gunyah on Qualcomm
	  platforms. Interaction with Qualcomm firmware requires
	  extra platform-specific support.

	  Say Y/M here to use Gunyah on Qualcomm platforms.

config GUNYAH_IRQFD
	tristate "Gunyah irqfd interface"
	depends on GUNYAH
	help
	  Enable kernel support for creating irqfds which can raise an interrupt
	  on Gunyah virtual machine.

	  Say Y/M here if unsure and you want to support Gunyah VMMs.

config GUNYAH_IOEVENTFD
	tristate "Gunyah ioeventfd interface"
	depends on GUNYAH
	help
	  Enable kernel support for creating ioeventfds which can alert userspace
	  when a Gunyah virtual machine accesses a memory address.

	  Say Y/M here if unsure and you want to support Gunyah VMMs.

config GUNYAH_QCOM_TRUSTED_VM
	tristate "Gunyah Qualcomm Trusted VM Support"
	depends on GUNYAH
	help
	  Enable kernel support for creating Qualcomm Trusted VMs.
	  They are a kind of protected VM which is authenticated by the
	  firmware.

	  Say Y/M here if unsure and you want to support QTVMs.

config GUNYAH_MEM_KUNIT_TEST
	bool "KUnit test of who holds VM memory after a failure" if !KUNIT_ALL_TESTS
	depends on KUNIT=y && !GUNYAH && MMU
	select GENERIC_ALLOCATOR
	default KUNIT_ALL_TESTS
	help
	  DiamaneOS: builds the Gunyah driver's memory code without the
	  hypervisor, for UML, with a scripted resource manager and
	  TrustZone. Memory the host may not own after a failed lend,
	  rollback or reclaim must stay pinned or out of the VM memory pool,
	  with its pieces still counted.

	  If unsure, say N.
```
